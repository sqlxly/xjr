#include "data_table.h"
//#include "bsp_clkconfig.h"

#include <string.h>
#include <stdio.h>
#include <math.h>

/****公共变量****/

AC2000 ac2000_table;
AC2000_DATA_TYPE *Ac2000Data=NULL;
AC2000_DATA_TYPE *Ac2000OldData=NULL;

int sum_ac2000(uint8_t *data,int len)
{
/*
	01 14 01 50 01 67 
	9b 
	0a 
*/	
	int result=0;
	uint8_t sum=0;
	if(len>=8)
	{
		for(uint32_t i=6;i<len-1;i++)
		{
			sum=sum+data[i];
		}
	}
	else
	{
		return result;
	}
	if(sum==data[len-1])
	{
	  result=1;	
	}
	else
	{
		result=0;
	}
	return result;
}
unsigned int server_crc_chk(unsigned char* data, unsigned short int length)
{
	uint16_t j;
	uint16_t reg_tmp=0xffff;
	union CONVERSE converse_tmp;
	uint16_t reg_crc=0xffff;
	while(length--)
	{
		reg_crc ^= *data++;
		for (j=0;j<8;j++)
		{
			if (reg_crc & 0x01) 
			{
				reg_crc=(reg_crc>>1) ^ 0xa001;//0xA = 1010;  0xA001   = 1010 0000 0000 0001
			}
			else 
			{
				reg_crc=reg_crc >>1;
			}
		}
	}
	reg_tmp=reg_crc;
	converse_tmp.data[1]=reg_tmp&0x00ff;
	converse_tmp.data[0]=(reg_tmp&0xff00)>>8;
	//DEBUG("modbus_crc=%04X\r\n",converse_tmp.value);
	return converse_tmp.value;  // the value that sent back to the CRC register finally
}
unsigned int crc_chk(unsigned char* data, unsigned short int length)
{
	int j;
	unsigned int reg_crc=0xffff;
	while(length--)
	{
		reg_crc ^= *data++;
		for (j=0;j<8;j++)
		{
			if (reg_crc & 0x01) 
			{
				reg_crc=(reg_crc>>1) ^ 0xa001;//0xA = 1010;  0xA001   = 1010 0000 0000 0001
			}
			else 
			{
				reg_crc=reg_crc >>1;
			}
		}
	}
	//DEBUG("crc=%04X\r\n",reg_crc);
	return reg_crc;  // the value that sent back to the CRC register finally
}
void AppendCRC(unsigned char *data,unsigned int crcValue)
{
	data[0]=crcValue%256;
	data[1]=crcValue/256;
}
float FourByteToFloat(unsigned char* byteArry)
{
	unsigned char buf_tmp[4];
//	buf_tmp[0] = byteArry[1];
//	buf_tmp[1] = byteArry[0];
//	buf_tmp[2] = byteArry[3];
//	buf_tmp[3] = byteArry[2];

	buf_tmp[0] = byteArry[0];
	buf_tmp[1] = byteArry[1];
	buf_tmp[2] = byteArry[2];
	buf_tmp[3] = byteArry[3];
	
	return *((float*)buf_tmp);
}


float orderFourByteToFloat(unsigned char* byteArry)
{
	unsigned char buf_tmp[4];
	buf_tmp[0] = byteArry[3];
	buf_tmp[1] = byteArry[2];
	buf_tmp[2] = byteArry[1];
	buf_tmp[3] = byteArry[0];
	
	return *((float*)buf_tmp);
}


void FloatToFourByte(float floatNum, unsigned char* byteArry)
{
	char *pchar = (char*)&floatNum;
	for (int i = 0;i<sizeof(float);i++)
	{
		*byteArry = *pchar;
		pchar++;
		byteArry++;
	}
}
float hexToFloatInverse(unsigned char *content)
{
	union lhex
	{
		unsigned char d[4];
		float f;
	}fdata;
	
	unsigned char buf_tmp[5];	
	buf_tmp[0]=content[1];
	buf_tmp[1]=content[0];
	buf_tmp[2]=content[3];
	buf_tmp[3]=content[2];
	buf_tmp[4]=0;
	
	for (int i = 0; i < 4; i++)
	{
		fdata.d[i] = buf_tmp[3-i];
	}
	//rt_kprintf("float_number:%f\r\n",fdata.f);
	return fdata.f;
}

void my_log(unsigned char *dataSource,uint16_t len)
{
	  rt_kprintf("\n");
		for(uint16_t i=0;i<len;i++)
		{
			rt_kprintf("%02x ",dataSource[i]);
		}
		rt_kprintf("\n");
}
void CreateAC2000Normal(const uint8_t CmdSource[][18],uint8_t *AC2000_SendBuff,uint8_t HenHouseNum,uint8_t CmdIndex)
{
	AC2000_SendBuff[0] = CmdSource[CmdIndex][0];
	AC2000_SendBuff[1] = CmdSource[CmdIndex][1];
	AC2000_SendBuff[2] = CmdSource[CmdIndex][2];
	AC2000_SendBuff[3] = CmdSource[CmdIndex][3];
	AC2000_SendBuff[4] = CmdSource[CmdIndex][4];
	AC2000_SendBuff[5] = CmdSource[CmdIndex][5];
	AC2000_SendBuff[6] = CmdSource[CmdIndex][6];
	AC2000_SendBuff[7] = CmdSource[CmdIndex][7];
	AC2000_SendBuff[8] = CmdSource[CmdIndex][8];
	AC2000_SendBuff[9] = CmdSource[CmdIndex][9];
	AC2000_SendBuff[10] = HenHouseNum;
	AC2000_SendBuff[11] = CmdSource[CmdIndex][11];
	AC2000_SendBuff[12] = CmdSource[CmdIndex][12];
	AC2000_SendBuff[13] = CmdSource[CmdIndex][13];
	AC2000_SendBuff[14] = CmdSource[CmdIndex][14];
	AC2000_SendBuff[15] = CmdSource[CmdIndex][15];
	AC2000_SendBuff[16] = CmdSource[CmdIndex][16];
	AC2000_SendBuff[17] = CmdSource[CmdIndex][17];
	
	uint8_t sum=0;
	for(uint16_t i=5;i<=16;i++)
	{
		sum=sum+AC2000_SendBuff[i];
	}
	AC2000_SendBuff[17]=sum;
	
	rt_kprintf("mcu send:\r\n");
	for(uint16_t i=0;i<18;i++)
	{
		rt_kprintf("%02x ",AC2000_SendBuff[i]);
	}
	rt_kprintf("\r\n");
	
}	

/****3G版变量****/
const AC2000_DATA_TYPE id_value_dot_range_3g[][2]=
{
	//id		小数位数	sensor_name
	{1801		,0	},    //3G版报警状态
	{1802		,0	},    //当前静压
	{1803		,0	},    //目标静压
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	{1932   ,0  },    //称重连接状态
};

const unsigned short AC2000WarmCode[]={
0XFFFF,	//控制器 异常报警 报警
0xCE00, //控制器 开关改变了 报警
0x7101, //控制器 温度传感器1断开了 报警 70
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0x2100, //控制器 紧急状态压力 报警
0x7402  //控制器 湿度传感器2故障 报警
};      

uint16_t AlarmCode3g[ALARM_NUM_3G][3]=
{
	{11515  ,  0  ,  0},//AC2000通信失败，请检查线路连接。
	{11433	,  0  ,  0},//水线一列-1层(1路) 缺水报警
	{11434	,  0  ,  0},//水线一列-2层(2路) 缺水报警
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	{13069	,  0  ,  0},//料塔称重通信故障
};

/****PALATINUM版变量****/
const AC2000_DATA_TYPE id_value_dot_range_platinum[][2]=
{
	//id	小数位数	sensor_name
	{2401	,2},//	平均温度
	{2402	,2},//	室外温度
	{2403	,0},//	通风级别
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	{2560	,0} //  继电器状态40
};

const unsigned short AC2000WarmCodePlatinum[]={
0XFFFF,	//控制器 异常报警 报警
0xCE00, //控制器 开关改变了 报警
0x7001, //控制器 温度传感器1断开了 报警
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0x2100, //控制器 紧急状态压力 报警
0x7402  //控制器 湿度传感器2故障 报警
};      

uint16_t AlarmCodePlatinum[ALARM_NUM_PLATINUM][3]=
{
	{13000,0,0},//	控制器 异常报警 报警
	{13001,0,0},//	控制器 开关改变了 报警
	{13002,0,0},//	控制器 温度传感器1断开了 报警
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	{13248,0,0} //	水线 48路 缺水报警
};	
	
